SECTIONS
{
    __romPos = 0;
    _gp = 0x0;
    header_ROM_START = __romPos;
    header_VRAM = ADDR(.header);
    .header : AT(header_ROM_START) SUBALIGN(16)
    {
        header_DATA_START = .;
        header_s = .;
        build/asm/header.s.o(.data);
        header_DATA_END = .;
        header_DATA_SIZE = ABSOLUTE(header_DATA_END - header_DATA_START);
    }
    __romPos += SIZEOF(.header);
    header_ROM_END = __romPos;
    header_VRAM_END = .;

    boot_ROM_START = __romPos;
    boot_VRAM = ADDR(.boot);
    .boot : AT(boot_ROM_START) SUBALIGN(16)
    {
        boot_DATA_START = .;
        boot_bin = .;
        build/assets/boot.bin.o(.data);
        boot_DATA_END = .;
        boot_DATA_SIZE = ABSOLUTE(boot_DATA_END - boot_DATA_START);
    }
    __romPos += SIZEOF(.boot);
    boot_ROM_END = __romPos;
    boot_VRAM_END = .;

    entry_ROM_START = __romPos;
    entry_VRAM = ADDR(.entry);
    .entry 0x80025C00 : AT(entry_ROM_START) SUBALIGN(16)
    {
        entry_TEXT_START = .;
        build/asm/1000.s.o(.text);
        entry_TEXT_END = .;
        entry_TEXT_SIZE = ABSOLUTE(entry_TEXT_END - entry_TEXT_START);
        entry_DATA_START = .;
        _1000_s = .;
        build/asm/1000.s.o(.data);
        entry_DATA_END = .;
        entry_DATA_SIZE = ABSOLUTE(entry_DATA_END - entry_DATA_START);
        entry_RODATA_START = .;
        build/asm/1000.s.o(.rodata);
        entry_RODATA_END = .;
        entry_RODATA_SIZE = ABSOLUTE(entry_RODATA_END - entry_RODATA_START);
    }
    entry_bss_VRAM = ADDR(.entry_bss);
    .entry_bss (NOLOAD) : SUBALIGN(16)
    {
        entry_BSS_START = .;
        build/asm/1000.s.o(.bss);
        entry_BSS_END = .;
        entry_BSS_SIZE = ABSOLUTE(entry_BSS_END - entry_BSS_START);
    }
    __romPos += SIZEOF(.entry);
    __romPos = ALIGN(__romPos, 16);
    entry_ROM_END = __romPos;
    entry_VRAM_END = .;

    main_ROM_START = __romPos;
    main_VRAM = ADDR(.main);
    .main entry_VRAM_END : AT(main_ROM_START) SUBALIGN(16)
    {
        main_DATA_START = .;
        _1050_bin = .;
        build/assets/1050.bin.o(.data);
        main_TEXT_START = .;
        build/src/1280.c.o(.text);
        build/src/21A0.c.o(.text);
        build/src/4CE0.c.o(.text);
        build/src/7C00.c.o(.text);
        build/src/7F50.c.o(.text);
        build/src/A4E0.c.o(.text);
        build/src/ABF0.c.o(.text);
        build/src/C1D0.c.o(.text);
        build/src/F0C0.c.o(.text);
        build/src/F290.c.o(.text);
        build/src/F950.c.o(.text);
        build/src/168D0.c.o(.text);
        build/src/17E40.c.o(.text);
        build/src/1CD60.c.o(.text);
        build/src/29A80.c.o(.text);
        build/src/2D860.c.o(.text);
        build/src/2F1D0.c.o(.text);
        build/src/30280.c.o(.text);
        build/src/361E0.c.o(.text);
        build/src/36E70.c.o(.text);
        build/src/37410.c.o(.text);
        build/src/391F0.c.o(.text);
        build/src/39960.c.o(.text);
        build/src/3CA40.c.o(.text);
        build/src/3DE90.c.o(.text);
        build/src/3F5E0.c.o(.text);
        build/src/42140.c.o(.text);
        build/src/42560.c.o(.text);
        build/src/43660.c.o(.text);
        build/src/46F10.c.o(.text);
        build/src/47000.c.o(.text);
        build/src/47550.c.o(.text);
        build/src/47B20.c.o(.text);
        build/src/47F70.c.o(.text);
        build/src/489E0.c.o(.text);
        build/src/49300.c.o(.text);
        build/src/49AA0.c.o(.text);
        build/src/4B550.c.o(.text);
        build/src/4D0D0.c.o(.text);
        build/src/4D8D0.c.o(.text);
        build/src/54490.c.o(.text);
        build/src/57D30.c.o(.text);
        build/src/586B0.c.o(.text);
        build/src/616E0.c.o(.text);
        build/src/618A0.c.o(.text);
        build/src/618D0.c.o(.text);
        build/src/61920.c.o(.text);
        build/src/61960.c.o(.text);
        build/src/619A0.c.o(.text);
        build/src/619E0.c.o(.text);
        build/src/61A10.c.o(.text);
        build/src/61A50.c.o(.text);
        build/src/61A90.c.o(.text);
        build/src/61AD0.c.o(.text);
        build/src/61B40.c.o(.text);
        build/src/61BB0.c.o(.text);
        build/src/61E30.c.o(.text);
        build/src/65F00.c.o(.text);
        build/src/66360.c.o(.text);
        build/src/66510.c.o(.text);
        build/src/667D0.c.o(.text);
        build/src/66A40.c.o(.text);
        build/src/679D0.c.o(.text);
        build/src/680F0.c.o(.text);
        build/src/682D0.c.o(.text);
        build/src/68CC0.c.o(.text);
        build/src/68D40.c.o(.text);
        build/src/68D90.c.o(.text);
        build/src/68F70.c.o(.text);
        build/src/69020.c.o(.text);
        build/src/690B0.c.o(.text);
        build/src/69140.c.o(.text);
        build/src/691F0.c.o(.text);
        build/src/69280.c.o(.text);
        build/src/69300.c.o(.text);
        build/src/69860.c.o(.text);
        build/src/698B0.c.o(.text);
        build/src/69980.c.o(.text);
        build/src/6A220.c.o(.text);
        build/src/6A6A0.c.o(.text);
        build/src/6A6C0.c.o(.text);
        build/src/6A6F0.c.o(.text);
        build/src/6A8B0.c.o(.text);
        build/src/6ABF0.c.o(.text);
        build/src/6AC30.c.o(.text);
        build/src/6ACC0.c.o(.text);
        build/src/6ACF0.c.o(.text);
        build/src/6AD30.c.o(.text);
        build/src/6AD90.c.o(.text);
        build/src/6B020.c.o(.text);
        build/src/6B080.c.o(.text);
        build/src/6B0C0.c.o(.text);
        build/src/6B1B0.c.o(.text);
        build/src/6B290.c.o(.text);
        build/src/6B2E0.c.o(.text);
        build/src/6B330.c.o(.text);
        build/src/6B370.c.o(.text);
        build/src/6B450.c.o(.text);
        build/src/6B490.c.o(.text);
        build/src/6B5C0.c.o(.text);
        build/src/6B600.c.o(.text);
        build/src/6B620.c.o(.text);
        build/src/6B730.c.o(.text);
        build/src/6BB30.c.o(.text);
        build/src/6BDF0.c.o(.text);
        build/src/6BE70.c.o(.text);
        build/src/6C290.c.o(.text);
        build/src/6C330.c.o(.text);
        build/src/6C4B0.c.o(.text);
        build/src/6C870.c.o(.text);
        build/src/6C960.c.o(.text);
        build/src/6CAA0.c.o(.text);
        build/src/6CB40.c.o(.text);
        build/src/6D370.c.o(.text);
        build/src/6DE80.c.o(.text);
        build/src/6DF90.c.o(.text);
        build/src/6EC60.c.o(.text);
        build/src/6F080.c.o(.text);
        build/src/6FC20.c.o(.text);
        build/src/6FDA0.c.o(.text);
        build/src/6FDE0.c.o(.text);
        build/src/6FE30.c.o(.text);
        build/src/6FE70.c.o(.text);
        build/src/704B0.c.o(.text);
        build/src/704C0.c.o(.text);
        build/src/70560.c.o(.text);
        build/src/70640.c.o(.text);
        build/src/708C0.c.o(.text);
        build/src/70BD0.c.o(.text);
        build/src/70C30.c.o(.text);
        build/src/70C40.c.o(.text);
        build/src/714A0.c.o(.text);
        build/src/71630.c.o(.text);
        build/src/71C30.c.o(.text);
        build/src/71C60.c.o(.text);
        build/src/71F40.c.o(.text);
        build/src/72260.c.o(.text);
        build/src/72340.c.o(.text);
        build/src/725B0.c.o(.text);
        build/src/729A0.c.o(.text);
        build/src/72AE0.c.o(.text);
        build/src/72C10.c.o(.text);
        build/src/72DF0.c.o(.text);
        build/src/73030.c.o(.text);
        build/src/73050.c.o(.text);
        build/src/730A0.c.o(.text);
        build/src/73B60.c.o(.text);
        build/src/73C50.c.o(.text);
        build/src/73D40.c.o(.text);
        build/src/73E10.c.o(.text);
        build/src/73F30.c.o(.text);
        build/src/73FF0.c.o(.text);
        build/src/74030.c.o(.text);
        build/src/74080.c.o(.text);
        build/src/74110.c.o(.text);
        build/src/741B0.c.o(.text);
        build/src/744B0.c.o(.text);
        build/src/74570.c.o(.text);
        build/src/745B0.c.o(.text);
        build/src/745F0.c.o(.text);
        build/src/74930.c.o(.text);
        build/src/74990.c.o(.text);
        build/src/749E0.c.o(.text);
        build/src/74B50.c.o(.text);
        build/src/74BA0.c.o(.text);
        build/src/74BF0.c.o(.text);
        build/src/74F00.c.o(.text);
        build/src/74F60.c.o(.text);
        build/src/75390.c.o(.text);
        build/src/755B0.c.o(.text);
        build/src/75B90.c.o(.text);
        build/src/75D50.c.o(.text);
        build/src/75E60.c.o(.text);
        build/src/76230.c.o(.text);
        build/src/76290.c.o(.text);
        build/src/764A0.c.o(.text);
        build/src/76510.c.o(.text);
        build/src/76FA0.c.o(.text);
        build/src/77190.c.o(.text);
        build/src/77400.c.o(.text);
        build/src/77420.c.o(.text);
        build/src/77710.c.o(.text);
        build/src/78110.c.o(.text);
        build/src/781A0.c.o(.text);
        build/src/78400.c.o(.text);
        build/src/78570.c.o(.text);
        build/src/78590.c.o(.text);
        build/src/78610.c.o(.text);
        build/src/78690.c.o(.text);
        build/src/78740.c.o(.text);
        build/src/788F0.c.o(.text);
        build/src/78900.c.o(.text);
        build/src/78910.c.o(.text);
        build/src/78920.c.o(.text);
        build/src/78930.c.o(.text);
        build/src/78980.c.o(.text);
        build/src/78A60.c.o(.text);
        build/src/78AB0.c.o(.text);
        build/src/78B00.c.o(.text);
        build/src/78BF0.c.o(.text);
        build/src/78CD0.c.o(.text);
        build/src/78D30.c.o(.text);
        build/src/78D80.c.o(.text);
        build/src/78E90.c.o(.text);
        build/src/78EA0.c.o(.text);
        build/src/798A0.c.o(.text);
        build/src/798C0.c.o(.text);
        build/src/798E0.c.o(.text);
        build/src/79D90.c.o(.text);
        build/src/79FB0.c.o(.text);
        build/src/7A220.c.o(.text);
        build/src/7A510.c.o(.text);
        build/src/7A610.c.o(.text);
        main_TEXT_END = .;
        main_TEXT_SIZE = ABSOLUTE(main_TEXT_END - main_TEXT_START);
        _7A620_bin = .;
        build/assets/7A620.bin.o(.data);
        _7A810_bin = .;
        build/assets/7A810.bin.o(.data);
        _1280_c = .;
        build/src/1280.c.o(.data);
        _21A0_c = .;
        build/src/21A0.c.o(.data);
        _4CE0_c = .;
        build/src/4CE0.c.o(.data);
        _7C00_c = .;
        build/src/7C00.c.o(.data);
        _7F50_c = .;
        build/src/7F50.c.o(.data);
        A4E0_c = .;
        build/src/A4E0.c.o(.data);
        ABF0_c = .;
        build/src/ABF0.c.o(.data);
        C1D0_c = .;
        build/src/C1D0.c.o(.data);
        F0C0_c = .;
        build/src/F0C0.c.o(.data);
        F290_c = .;
        build/src/F290.c.o(.data);
        F950_c = .;
        build/src/F950.c.o(.data);
        _168D0_c = .;
        build/src/168D0.c.o(.data);
        _17E40_c = .;
        build/src/17E40.c.o(.data);
        _1CD60_c = .;
        build/src/1CD60.c.o(.data);
        _29A80_c = .;
        build/src/29A80.c.o(.data);
        _2D860_c = .;
        build/src/2D860.c.o(.data);
        _2F1D0_c = .;
        build/src/2F1D0.c.o(.data);
        _30280_c = .;
        build/src/30280.c.o(.data);
        _361E0_c = .;
        build/src/361E0.c.o(.data);
        _36E70_c = .;
        build/src/36E70.c.o(.data);
        _37410_c = .;
        build/src/37410.c.o(.data);
        _391F0_c = .;
        build/src/391F0.c.o(.data);
        _39960_c = .;
        build/src/39960.c.o(.data);
        _3CA40_c = .;
        build/src/3CA40.c.o(.data);
        _3DE90_c = .;
        build/src/3DE90.c.o(.data);
        _3F5E0_c = .;
        build/src/3F5E0.c.o(.data);
        _42140_c = .;
        build/src/42140.c.o(.data);
        _42560_c = .;
        build/src/42560.c.o(.data);
        _43660_c = .;
        build/src/43660.c.o(.data);
        _46F10_c = .;
        build/src/46F10.c.o(.data);
        _47000_c = .;
        build/src/47000.c.o(.data);
        _47550_c = .;
        build/src/47550.c.o(.data);
        _47B20_c = .;
        build/src/47B20.c.o(.data);
        _47F70_c = .;
        build/src/47F70.c.o(.data);
        _489E0_c = .;
        build/src/489E0.c.o(.data);
        _49300_c = .;
        build/src/49300.c.o(.data);
        _49AA0_c = .;
        build/src/49AA0.c.o(.data);
        _4B550_c = .;
        build/src/4B550.c.o(.data);
        _4D0D0_c = .;
        build/src/4D0D0.c.o(.data);
        _4D8D0_c = .;
        build/src/4D8D0.c.o(.data);
        _54490_c = .;
        build/src/54490.c.o(.data);
        _57D30_c = .;
        build/src/57D30.c.o(.data);
        _586B0_c = .;
        build/src/586B0.c.o(.data);
        _616E0_c = .;
        build/src/616E0.c.o(.data);
        _618A0_c = .;
        build/src/618A0.c.o(.data);
        _618D0_c = .;
        build/src/618D0.c.o(.data);
        _61920_c = .;
        build/src/61920.c.o(.data);
        _61960_c = .;
        build/src/61960.c.o(.data);
        _619A0_c = .;
        build/src/619A0.c.o(.data);
        _619E0_c = .;
        build/src/619E0.c.o(.data);
        _61A10_c = .;
        build/src/61A10.c.o(.data);
        _61A50_c = .;
        build/src/61A50.c.o(.data);
        _61A90_c = .;
        build/src/61A90.c.o(.data);
        _61AD0_c = .;
        build/src/61AD0.c.o(.data);
        _61B40_c = .;
        build/src/61B40.c.o(.data);
        _61BB0_c = .;
        build/src/61BB0.c.o(.data);
        _61E30_c = .;
        build/src/61E30.c.o(.data);
        _65F00_c = .;
        build/src/65F00.c.o(.data);
        _66360_c = .;
        build/src/66360.c.o(.data);
        _66510_c = .;
        build/src/66510.c.o(.data);
        _667D0_c = .;
        build/src/667D0.c.o(.data);
        _66A40_c = .;
        build/src/66A40.c.o(.data);
        _679D0_c = .;
        build/src/679D0.c.o(.data);
        _680F0_c = .;
        build/src/680F0.c.o(.data);
        _682D0_c = .;
        build/src/682D0.c.o(.data);
        _68CC0_c = .;
        build/src/68CC0.c.o(.data);
        _68D40_c = .;
        build/src/68D40.c.o(.data);
        _68D90_c = .;
        build/src/68D90.c.o(.data);
        _68F70_c = .;
        build/src/68F70.c.o(.data);
        _69020_c = .;
        build/src/69020.c.o(.data);
        _690B0_c = .;
        build/src/690B0.c.o(.data);
        _69140_c = .;
        build/src/69140.c.o(.data);
        _691F0_c = .;
        build/src/691F0.c.o(.data);
        _69280_c = .;
        build/src/69280.c.o(.data);
        _69300_c = .;
        build/src/69300.c.o(.data);
        _69860_c = .;
        build/src/69860.c.o(.data);
        _698B0_c = .;
        build/src/698B0.c.o(.data);
        _69980_c = .;
        build/src/69980.c.o(.data);
        _6A220_c = .;
        build/src/6A220.c.o(.data);
        _6A6A0_c = .;
        build/src/6A6A0.c.o(.data);
        _6A6C0_c = .;
        build/src/6A6C0.c.o(.data);
        _6A6F0_c = .;
        build/src/6A6F0.c.o(.data);
        _6A8B0_c = .;
        build/src/6A8B0.c.o(.data);
        _6ABF0_c = .;
        build/src/6ABF0.c.o(.data);
        _6AC30_c = .;
        build/src/6AC30.c.o(.data);
        _6ACC0_c = .;
        build/src/6ACC0.c.o(.data);
        _6ACF0_c = .;
        build/src/6ACF0.c.o(.data);
        _6AD30_c = .;
        build/src/6AD30.c.o(.data);
        _6AD90_c = .;
        build/src/6AD90.c.o(.data);
        _6B020_c = .;
        build/src/6B020.c.o(.data);
        _6B080_c = .;
        build/src/6B080.c.o(.data);
        _6B0C0_c = .;
        build/src/6B0C0.c.o(.data);
        _6B1B0_c = .;
        build/src/6B1B0.c.o(.data);
        _6B290_c = .;
        build/src/6B290.c.o(.data);
        _6B2E0_c = .;
        build/src/6B2E0.c.o(.data);
        _6B330_c = .;
        build/src/6B330.c.o(.data);
        _6B370_c = .;
        build/src/6B370.c.o(.data);
        _6B450_c = .;
        build/src/6B450.c.o(.data);
        _6B490_c = .;
        build/src/6B490.c.o(.data);
        _6B5C0_c = .;
        build/src/6B5C0.c.o(.data);
        _6B600_c = .;
        build/src/6B600.c.o(.data);
        _6B620_c = .;
        build/src/6B620.c.o(.data);
        _6B730_c = .;
        build/src/6B730.c.o(.data);
        _6BB30_c = .;
        build/src/6BB30.c.o(.data);
        _6BDF0_c = .;
        build/src/6BDF0.c.o(.data);
        _6BE70_c = .;
        build/src/6BE70.c.o(.data);
        _6C290_c = .;
        build/src/6C290.c.o(.data);
        _6C330_c = .;
        build/src/6C330.c.o(.data);
        _6C4B0_c = .;
        build/src/6C4B0.c.o(.data);
        _6C870_c = .;
        build/src/6C870.c.o(.data);
        _6C960_c = .;
        build/src/6C960.c.o(.data);
        _6CAA0_c = .;
        build/src/6CAA0.c.o(.data);
        _6CB40_c = .;
        build/src/6CB40.c.o(.data);
        _6D370_c = .;
        build/src/6D370.c.o(.data);
        _6DE80_c = .;
        build/src/6DE80.c.o(.data);
        _6DF90_c = .;
        build/src/6DF90.c.o(.data);
        _6EC60_c = .;
        build/src/6EC60.c.o(.data);
        _6F080_c = .;
        build/src/6F080.c.o(.data);
        _6FC20_c = .;
        build/src/6FC20.c.o(.data);
        _6FDA0_c = .;
        build/src/6FDA0.c.o(.data);
        _6FDE0_c = .;
        build/src/6FDE0.c.o(.data);
        _6FE30_c = .;
        build/src/6FE30.c.o(.data);
        _6FE70_c = .;
        build/src/6FE70.c.o(.data);
        _704B0_c = .;
        build/src/704B0.c.o(.data);
        _704C0_c = .;
        build/src/704C0.c.o(.data);
        _70560_c = .;
        build/src/70560.c.o(.data);
        _70640_c = .;
        build/src/70640.c.o(.data);
        _708C0_c = .;
        build/src/708C0.c.o(.data);
        _70BD0_c = .;
        build/src/70BD0.c.o(.data);
        _70C30_c = .;
        build/src/70C30.c.o(.data);
        _70C40_c = .;
        build/src/70C40.c.o(.data);
        _714A0_c = .;
        build/src/714A0.c.o(.data);
        _71630_c = .;
        build/src/71630.c.o(.data);
        _71C30_c = .;
        build/src/71C30.c.o(.data);
        _71C60_c = .;
        build/src/71C60.c.o(.data);
        _71F40_c = .;
        build/src/71F40.c.o(.data);
        _72260_c = .;
        build/src/72260.c.o(.data);
        _72340_c = .;
        build/src/72340.c.o(.data);
        _725B0_c = .;
        build/src/725B0.c.o(.data);
        _729A0_c = .;
        build/src/729A0.c.o(.data);
        _72AE0_c = .;
        build/src/72AE0.c.o(.data);
        _72C10_c = .;
        build/src/72C10.c.o(.data);
        _72DF0_c = .;
        build/src/72DF0.c.o(.data);
        _73030_c = .;
        build/src/73030.c.o(.data);
        _73050_c = .;
        build/src/73050.c.o(.data);
        _730A0_c = .;
        build/src/730A0.c.o(.data);
        _73B60_c = .;
        build/src/73B60.c.o(.data);
        _73C50_c = .;
        build/src/73C50.c.o(.data);
        _73D40_c = .;
        build/src/73D40.c.o(.data);
        _73E10_c = .;
        build/src/73E10.c.o(.data);
        _73F30_c = .;
        build/src/73F30.c.o(.data);
        _73FF0_c = .;
        build/src/73FF0.c.o(.data);
        _74030_c = .;
        build/src/74030.c.o(.data);
        _74080_c = .;
        build/src/74080.c.o(.data);
        _74110_c = .;
        build/src/74110.c.o(.data);
        _741B0_c = .;
        build/src/741B0.c.o(.data);
        _744B0_c = .;
        build/src/744B0.c.o(.data);
        _74570_c = .;
        build/src/74570.c.o(.data);
        _745B0_c = .;
        build/src/745B0.c.o(.data);
        _745F0_c = .;
        build/src/745F0.c.o(.data);
        _74930_c = .;
        build/src/74930.c.o(.data);
        _74990_c = .;
        build/src/74990.c.o(.data);
        _749E0_c = .;
        build/src/749E0.c.o(.data);
        _74B50_c = .;
        build/src/74B50.c.o(.data);
        _74BA0_c = .;
        build/src/74BA0.c.o(.data);
        _74BF0_c = .;
        build/src/74BF0.c.o(.data);
        _74F00_c = .;
        build/src/74F00.c.o(.data);
        _74F60_c = .;
        build/src/74F60.c.o(.data);
        _75390_c = .;
        build/src/75390.c.o(.data);
        _755B0_c = .;
        build/src/755B0.c.o(.data);
        _75B90_c = .;
        build/src/75B90.c.o(.data);
        _75D50_c = .;
        build/src/75D50.c.o(.data);
        _75E60_c = .;
        build/src/75E60.c.o(.data);
        _76230_c = .;
        build/src/76230.c.o(.data);
        _76290_c = .;
        build/src/76290.c.o(.data);
        _764A0_c = .;
        build/src/764A0.c.o(.data);
        _76510_c = .;
        build/src/76510.c.o(.data);
        _76FA0_c = .;
        build/src/76FA0.c.o(.data);
        _77190_c = .;
        build/src/77190.c.o(.data);
        _77400_c = .;
        build/src/77400.c.o(.data);
        _77420_c = .;
        build/src/77420.c.o(.data);
        _77710_c = .;
        build/src/77710.c.o(.data);
        _78110_c = .;
        build/src/78110.c.o(.data);
        _781A0_c = .;
        build/src/781A0.c.o(.data);
        _78400_c = .;
        build/src/78400.c.o(.data);
        _78570_c = .;
        build/src/78570.c.o(.data);
        _78590_c = .;
        build/src/78590.c.o(.data);
        _78610_c = .;
        build/src/78610.c.o(.data);
        _78690_c = .;
        build/src/78690.c.o(.data);
        _78740_c = .;
        build/src/78740.c.o(.data);
        _788F0_c = .;
        build/src/788F0.c.o(.data);
        _78900_c = .;
        build/src/78900.c.o(.data);
        _78910_c = .;
        build/src/78910.c.o(.data);
        _78920_c = .;
        build/src/78920.c.o(.data);
        _78930_c = .;
        build/src/78930.c.o(.data);
        _78980_c = .;
        build/src/78980.c.o(.data);
        _78A60_c = .;
        build/src/78A60.c.o(.data);
        _78AB0_c = .;
        build/src/78AB0.c.o(.data);
        _78B00_c = .;
        build/src/78B00.c.o(.data);
        _78BF0_c = .;
        build/src/78BF0.c.o(.data);
        _78CD0_c = .;
        build/src/78CD0.c.o(.data);
        _78D30_c = .;
        build/src/78D30.c.o(.data);
        _78D80_c = .;
        build/src/78D80.c.o(.data);
        _78E90_c = .;
        build/src/78E90.c.o(.data);
        _78EA0_c = .;
        build/src/78EA0.c.o(.data);
        _798A0_c = .;
        build/src/798A0.c.o(.data);
        _798C0_c = .;
        build/src/798C0.c.o(.data);
        _798E0_c = .;
        build/src/798E0.c.o(.data);
        _79D90_c = .;
        build/src/79D90.c.o(.data);
        _79FB0_c = .;
        build/src/79FB0.c.o(.data);
        _7A220_c = .;
        build/src/7A220.c.o(.data);
        _7A510_c = .;
        build/src/7A510.c.o(.data);
        _7A610_c = .;
        build/src/7A610.c.o(.data);
        main_DATA_END = .;
        main_DATA_SIZE = ABSOLUTE(main_DATA_END - main_DATA_START);
        main_RODATA_START = .;
        build/src/1280.c.o(.rodata);
        build/src/21A0.c.o(.rodata);
        build/src/4CE0.c.o(.rodata);
        build/src/7C00.c.o(.rodata);
        build/src/7F50.c.o(.rodata);
        build/src/A4E0.c.o(.rodata);
        build/src/ABF0.c.o(.rodata);
        build/src/C1D0.c.o(.rodata);
        build/src/F0C0.c.o(.rodata);
        build/src/F290.c.o(.rodata);
        build/src/F950.c.o(.rodata);
        build/src/168D0.c.o(.rodata);
        build/src/17E40.c.o(.rodata);
        build/src/1CD60.c.o(.rodata);
        build/src/29A80.c.o(.rodata);
        build/src/2D860.c.o(.rodata);
        build/src/2F1D0.c.o(.rodata);
        build/src/30280.c.o(.rodata);
        build/src/361E0.c.o(.rodata);
        build/src/36E70.c.o(.rodata);
        build/src/37410.c.o(.rodata);
        build/src/391F0.c.o(.rodata);
        build/src/39960.c.o(.rodata);
        build/src/3CA40.c.o(.rodata);
        build/src/3DE90.c.o(.rodata);
        build/src/3F5E0.c.o(.rodata);
        build/src/42140.c.o(.rodata);
        build/src/42560.c.o(.rodata);
        build/src/43660.c.o(.rodata);
        build/src/46F10.c.o(.rodata);
        build/src/47000.c.o(.rodata);
        build/src/47550.c.o(.rodata);
        build/src/47B20.c.o(.rodata);
        build/src/47F70.c.o(.rodata);
        build/src/489E0.c.o(.rodata);
        build/src/49300.c.o(.rodata);
        build/src/49AA0.c.o(.rodata);
        build/src/4B550.c.o(.rodata);
        build/src/4D0D0.c.o(.rodata);
        build/src/4D8D0.c.o(.rodata);
        build/src/54490.c.o(.rodata);
        build/src/57D30.c.o(.rodata);
        build/src/586B0.c.o(.rodata);
        build/src/616E0.c.o(.rodata);
        build/src/618A0.c.o(.rodata);
        build/src/618D0.c.o(.rodata);
        build/src/61920.c.o(.rodata);
        build/src/61960.c.o(.rodata);
        build/src/619A0.c.o(.rodata);
        build/src/619E0.c.o(.rodata);
        build/src/61A10.c.o(.rodata);
        build/src/61A50.c.o(.rodata);
        build/src/61A90.c.o(.rodata);
        build/src/61AD0.c.o(.rodata);
        build/src/61B40.c.o(.rodata);
        build/src/61BB0.c.o(.rodata);
        build/src/61E30.c.o(.rodata);
        build/src/65F00.c.o(.rodata);
        build/src/66360.c.o(.rodata);
        build/src/66510.c.o(.rodata);
        build/src/667D0.c.o(.rodata);
        build/src/66A40.c.o(.rodata);
        build/src/679D0.c.o(.rodata);
        build/src/680F0.c.o(.rodata);
        build/src/682D0.c.o(.rodata);
        build/src/68CC0.c.o(.rodata);
        build/src/68D40.c.o(.rodata);
        build/src/68D90.c.o(.rodata);
        build/src/68F70.c.o(.rodata);
        build/src/69020.c.o(.rodata);
        build/src/690B0.c.o(.rodata);
        build/src/69140.c.o(.rodata);
        build/src/691F0.c.o(.rodata);
        build/src/69280.c.o(.rodata);
        build/src/69300.c.o(.rodata);
        build/src/69860.c.o(.rodata);
        build/src/698B0.c.o(.rodata);
        build/src/69980.c.o(.rodata);
        build/src/6A220.c.o(.rodata);
        build/src/6A6A0.c.o(.rodata);
        build/src/6A6C0.c.o(.rodata);
        build/src/6A6F0.c.o(.rodata);
        build/src/6A8B0.c.o(.rodata);
        build/src/6ABF0.c.o(.rodata);
        build/src/6AC30.c.o(.rodata);
        build/src/6ACC0.c.o(.rodata);
        build/src/6ACF0.c.o(.rodata);
        build/src/6AD30.c.o(.rodata);
        build/src/6AD90.c.o(.rodata);
        build/src/6B020.c.o(.rodata);
        build/src/6B080.c.o(.rodata);
        build/src/6B0C0.c.o(.rodata);
        build/src/6B1B0.c.o(.rodata);
        build/src/6B290.c.o(.rodata);
        build/src/6B2E0.c.o(.rodata);
        build/src/6B330.c.o(.rodata);
        build/src/6B370.c.o(.rodata);
        build/src/6B450.c.o(.rodata);
        build/src/6B490.c.o(.rodata);
        build/src/6B5C0.c.o(.rodata);
        build/src/6B600.c.o(.rodata);
        build/src/6B620.c.o(.rodata);
        build/src/6B730.c.o(.rodata);
        build/src/6BB30.c.o(.rodata);
        build/src/6BDF0.c.o(.rodata);
        build/src/6BE70.c.o(.rodata);
        build/src/6C290.c.o(.rodata);
        build/src/6C330.c.o(.rodata);
        build/src/6C4B0.c.o(.rodata);
        build/src/6C870.c.o(.rodata);
        build/src/6C960.c.o(.rodata);
        build/src/6CAA0.c.o(.rodata);
        build/src/6CB40.c.o(.rodata);
        build/src/6D370.c.o(.rodata);
        build/src/6DE80.c.o(.rodata);
        build/src/6DF90.c.o(.rodata);
        build/src/6EC60.c.o(.rodata);
        build/src/6F080.c.o(.rodata);
        build/src/6FC20.c.o(.rodata);
        build/src/6FDA0.c.o(.rodata);
        build/src/6FDE0.c.o(.rodata);
        build/src/6FE30.c.o(.rodata);
        build/src/6FE70.c.o(.rodata);
        build/src/704B0.c.o(.rodata);
        build/src/704C0.c.o(.rodata);
        build/src/70560.c.o(.rodata);
        build/src/70640.c.o(.rodata);
        build/src/708C0.c.o(.rodata);
        build/src/70BD0.c.o(.rodata);
        build/src/70C30.c.o(.rodata);
        build/src/70C40.c.o(.rodata);
        build/src/714A0.c.o(.rodata);
        build/src/71630.c.o(.rodata);
        build/src/71C30.c.o(.rodata);
        build/src/71C60.c.o(.rodata);
        build/src/71F40.c.o(.rodata);
        build/src/72260.c.o(.rodata);
        build/src/72340.c.o(.rodata);
        build/src/725B0.c.o(.rodata);
        build/src/729A0.c.o(.rodata);
        build/src/72AE0.c.o(.rodata);
        build/src/72C10.c.o(.rodata);
        build/src/72DF0.c.o(.rodata);
        build/src/73030.c.o(.rodata);
        build/src/73050.c.o(.rodata);
        build/src/730A0.c.o(.rodata);
        build/src/73B60.c.o(.rodata);
        build/src/73C50.c.o(.rodata);
        build/src/73D40.c.o(.rodata);
        build/src/73E10.c.o(.rodata);
        build/src/73F30.c.o(.rodata);
        build/src/73FF0.c.o(.rodata);
        build/src/74030.c.o(.rodata);
        build/src/74080.c.o(.rodata);
        build/src/74110.c.o(.rodata);
        build/src/741B0.c.o(.rodata);
        build/src/744B0.c.o(.rodata);
        build/src/74570.c.o(.rodata);
        build/src/745B0.c.o(.rodata);
        build/src/745F0.c.o(.rodata);
        build/src/74930.c.o(.rodata);
        build/src/74990.c.o(.rodata);
        build/src/749E0.c.o(.rodata);
        build/src/74B50.c.o(.rodata);
        build/src/74BA0.c.o(.rodata);
        build/src/74BF0.c.o(.rodata);
        build/src/74F00.c.o(.rodata);
        build/src/74F60.c.o(.rodata);
        build/src/75390.c.o(.rodata);
        build/src/755B0.c.o(.rodata);
        build/src/75B90.c.o(.rodata);
        build/src/75D50.c.o(.rodata);
        build/src/75E60.c.o(.rodata);
        build/src/76230.c.o(.rodata);
        build/src/76290.c.o(.rodata);
        build/src/764A0.c.o(.rodata);
        build/src/76510.c.o(.rodata);
        build/src/76FA0.c.o(.rodata);
        build/src/77190.c.o(.rodata);
        build/src/77400.c.o(.rodata);
        build/src/77420.c.o(.rodata);
        build/src/77710.c.o(.rodata);
        build/src/78110.c.o(.rodata);
        build/src/781A0.c.o(.rodata);
        build/src/78400.c.o(.rodata);
        build/src/78570.c.o(.rodata);
        build/src/78590.c.o(.rodata);
        build/src/78610.c.o(.rodata);
        build/src/78690.c.o(.rodata);
        build/src/78740.c.o(.rodata);
        build/src/788F0.c.o(.rodata);
        build/src/78900.c.o(.rodata);
        build/src/78910.c.o(.rodata);
        build/src/78920.c.o(.rodata);
        build/src/78930.c.o(.rodata);
        build/src/78980.c.o(.rodata);
        build/src/78A60.c.o(.rodata);
        build/src/78AB0.c.o(.rodata);
        build/src/78B00.c.o(.rodata);
        build/src/78BF0.c.o(.rodata);
        build/src/78CD0.c.o(.rodata);
        build/src/78D30.c.o(.rodata);
        build/src/78D80.c.o(.rodata);
        build/src/78E90.c.o(.rodata);
        build/src/78EA0.c.o(.rodata);
        build/src/798A0.c.o(.rodata);
        build/src/798C0.c.o(.rodata);
        build/src/798E0.c.o(.rodata);
        build/src/79D90.c.o(.rodata);
        build/src/79FB0.c.o(.rodata);
        build/src/7A220.c.o(.rodata);
        build/src/7A510.c.o(.rodata);
        build/src/7A610.c.o(.rodata);
        main_RODATA_END = .;
        main_RODATA_SIZE = ABSOLUTE(main_RODATA_END - main_RODATA_START);
    }
    main_bss_VRAM = ADDR(.main_bss);
    .main_bss (NOLOAD) : SUBALIGN(16)
    {
        main_BSS_START = .;
        build/src/1280.c.o(.bss);
        build/src/21A0.c.o(.bss);
        build/src/4CE0.c.o(.bss);
        build/src/7C00.c.o(.bss);
        build/src/7F50.c.o(.bss);
        build/src/A4E0.c.o(.bss);
        build/src/ABF0.c.o(.bss);
        build/src/C1D0.c.o(.bss);
        build/src/F0C0.c.o(.bss);
        build/src/F290.c.o(.bss);
        build/src/F950.c.o(.bss);
        build/src/168D0.c.o(.bss);
        build/src/17E40.c.o(.bss);
        build/src/1CD60.c.o(.bss);
        build/src/29A80.c.o(.bss);
        build/src/2D860.c.o(.bss);
        build/src/2F1D0.c.o(.bss);
        build/src/30280.c.o(.bss);
        build/src/361E0.c.o(.bss);
        build/src/36E70.c.o(.bss);
        build/src/37410.c.o(.bss);
        build/src/391F0.c.o(.bss);
        build/src/39960.c.o(.bss);
        build/src/3CA40.c.o(.bss);
        build/src/3DE90.c.o(.bss);
        build/src/3F5E0.c.o(.bss);
        build/src/42140.c.o(.bss);
        build/src/42560.c.o(.bss);
        build/src/43660.c.o(.bss);
        build/src/46F10.c.o(.bss);
        build/src/47000.c.o(.bss);
        build/src/47550.c.o(.bss);
        build/src/47B20.c.o(.bss);
        build/src/47F70.c.o(.bss);
        build/src/489E0.c.o(.bss);
        build/src/49300.c.o(.bss);
        build/src/49AA0.c.o(.bss);
        build/src/4B550.c.o(.bss);
        build/src/4D0D0.c.o(.bss);
        build/src/4D8D0.c.o(.bss);
        build/src/54490.c.o(.bss);
        build/src/57D30.c.o(.bss);
        build/src/586B0.c.o(.bss);
        build/src/616E0.c.o(.bss);
        build/src/618A0.c.o(.bss);
        build/src/618D0.c.o(.bss);
        build/src/61920.c.o(.bss);
        build/src/61960.c.o(.bss);
        build/src/619A0.c.o(.bss);
        build/src/619E0.c.o(.bss);
        build/src/61A10.c.o(.bss);
        build/src/61A50.c.o(.bss);
        build/src/61A90.c.o(.bss);
        build/src/61AD0.c.o(.bss);
        build/src/61B40.c.o(.bss);
        build/src/61BB0.c.o(.bss);
        build/src/61E30.c.o(.bss);
        build/src/65F00.c.o(.bss);
        build/src/66360.c.o(.bss);
        build/src/66510.c.o(.bss);
        build/src/667D0.c.o(.bss);
        build/src/66A40.c.o(.bss);
        build/src/679D0.c.o(.bss);
        build/src/680F0.c.o(.bss);
        build/src/682D0.c.o(.bss);
        build/src/68CC0.c.o(.bss);
        build/src/68D40.c.o(.bss);
        build/src/68D90.c.o(.bss);
        build/src/68F70.c.o(.bss);
        build/src/69020.c.o(.bss);
        build/src/690B0.c.o(.bss);
        build/src/69140.c.o(.bss);
        build/src/691F0.c.o(.bss);
        build/src/69280.c.o(.bss);
        build/src/69300.c.o(.bss);
        build/src/69860.c.o(.bss);
        build/src/698B0.c.o(.bss);
        build/src/69980.c.o(.bss);
        build/src/6A220.c.o(.bss);
        build/src/6A6A0.c.o(.bss);
        build/src/6A6C0.c.o(.bss);
        build/src/6A6F0.c.o(.bss);
        build/src/6A8B0.c.o(.bss);
        build/src/6ABF0.c.o(.bss);
        build/src/6AC30.c.o(.bss);
        build/src/6ACC0.c.o(.bss);
        build/src/6ACF0.c.o(.bss);
        build/src/6AD30.c.o(.bss);
        build/src/6AD90.c.o(.bss);
        build/src/6B020.c.o(.bss);
        build/src/6B080.c.o(.bss);
        build/src/6B0C0.c.o(.bss);
        build/src/6B1B0.c.o(.bss);
        build/src/6B290.c.o(.bss);
        build/src/6B2E0.c.o(.bss);
        build/src/6B330.c.o(.bss);
        build/src/6B370.c.o(.bss);
        build/src/6B450.c.o(.bss);
        build/src/6B490.c.o(.bss);
        build/src/6B5C0.c.o(.bss);
        build/src/6B600.c.o(.bss);
        build/src/6B620.c.o(.bss);
        build/src/6B730.c.o(.bss);
        build/src/6BB30.c.o(.bss);
        build/src/6BDF0.c.o(.bss);
        build/src/6BE70.c.o(.bss);
        build/src/6C290.c.o(.bss);
        build/src/6C330.c.o(.bss);
        build/src/6C4B0.c.o(.bss);
        build/src/6C870.c.o(.bss);
        build/src/6C960.c.o(.bss);
        build/src/6CAA0.c.o(.bss);
        build/src/6CB40.c.o(.bss);
        build/src/6D370.c.o(.bss);
        build/src/6DE80.c.o(.bss);
        build/src/6DF90.c.o(.bss);
        build/src/6EC60.c.o(.bss);
        build/src/6F080.c.o(.bss);
        build/src/6FC20.c.o(.bss);
        build/src/6FDA0.c.o(.bss);
        build/src/6FDE0.c.o(.bss);
        build/src/6FE30.c.o(.bss);
        build/src/6FE70.c.o(.bss);
        build/src/704B0.c.o(.bss);
        build/src/704C0.c.o(.bss);
        build/src/70560.c.o(.bss);
        build/src/70640.c.o(.bss);
        build/src/708C0.c.o(.bss);
        build/src/70BD0.c.o(.bss);
        build/src/70C30.c.o(.bss);
        build/src/70C40.c.o(.bss);
        build/src/714A0.c.o(.bss);
        build/src/71630.c.o(.bss);
        build/src/71C30.c.o(.bss);
        build/src/71C60.c.o(.bss);
        build/src/71F40.c.o(.bss);
        build/src/72260.c.o(.bss);
        build/src/72340.c.o(.bss);
        build/src/725B0.c.o(.bss);
        build/src/729A0.c.o(.bss);
        build/src/72AE0.c.o(.bss);
        build/src/72C10.c.o(.bss);
        build/src/72DF0.c.o(.bss);
        build/src/73030.c.o(.bss);
        build/src/73050.c.o(.bss);
        build/src/730A0.c.o(.bss);
        build/src/73B60.c.o(.bss);
        build/src/73C50.c.o(.bss);
        build/src/73D40.c.o(.bss);
        build/src/73E10.c.o(.bss);
        build/src/73F30.c.o(.bss);
        build/src/73FF0.c.o(.bss);
        build/src/74030.c.o(.bss);
        build/src/74080.c.o(.bss);
        build/src/74110.c.o(.bss);
        build/src/741B0.c.o(.bss);
        build/src/744B0.c.o(.bss);
        build/src/74570.c.o(.bss);
        build/src/745B0.c.o(.bss);
        build/src/745F0.c.o(.bss);
        build/src/74930.c.o(.bss);
        build/src/74990.c.o(.bss);
        build/src/749E0.c.o(.bss);
        build/src/74B50.c.o(.bss);
        build/src/74BA0.c.o(.bss);
        build/src/74BF0.c.o(.bss);
        build/src/74F00.c.o(.bss);
        build/src/74F60.c.o(.bss);
        build/src/75390.c.o(.bss);
        build/src/755B0.c.o(.bss);
        build/src/75B90.c.o(.bss);
        build/src/75D50.c.o(.bss);
        build/src/75E60.c.o(.bss);
        build/src/76230.c.o(.bss);
        build/src/76290.c.o(.bss);
        build/src/764A0.c.o(.bss);
        build/src/76510.c.o(.bss);
        build/src/76FA0.c.o(.bss);
        build/src/77190.c.o(.bss);
        build/src/77400.c.o(.bss);
        build/src/77420.c.o(.bss);
        build/src/77710.c.o(.bss);
        build/src/78110.c.o(.bss);
        build/src/781A0.c.o(.bss);
        build/src/78400.c.o(.bss);
        build/src/78570.c.o(.bss);
        build/src/78590.c.o(.bss);
        build/src/78610.c.o(.bss);
        build/src/78690.c.o(.bss);
        build/src/78740.c.o(.bss);
        build/src/788F0.c.o(.bss);
        build/src/78900.c.o(.bss);
        build/src/78910.c.o(.bss);
        build/src/78920.c.o(.bss);
        build/src/78930.c.o(.bss);
        build/src/78980.c.o(.bss);
        build/src/78A60.c.o(.bss);
        build/src/78AB0.c.o(.bss);
        build/src/78B00.c.o(.bss);
        build/src/78BF0.c.o(.bss);
        build/src/78CD0.c.o(.bss);
        build/src/78D30.c.o(.bss);
        build/src/78D80.c.o(.bss);
        build/src/78E90.c.o(.bss);
        build/src/78EA0.c.o(.bss);
        build/src/798A0.c.o(.bss);
        build/src/798C0.c.o(.bss);
        build/src/798E0.c.o(.bss);
        build/src/79D90.c.o(.bss);
        build/src/79FB0.c.o(.bss);
        build/src/7A220.c.o(.bss);
        build/src/7A510.c.o(.bss);
        build/src/7A610.c.o(.bss);
        main_BSS_END = .;
        main_BSS_SIZE = ABSOLUTE(main_BSS_END - main_BSS_START);
    }
    __romPos += SIZEOF(.main);
    __romPos = ALIGN(__romPos, 16);
    main_ROM_END = __romPos;
    main_VRAM_END = .;

    _8BE60_ROM_START = __romPos;
    _8BE60_VRAM = ADDR(._8BE60);
    ._8BE60 main_VRAM_END : AT(_8BE60_ROM_START) SUBALIGN(16)
    {
        _8BE60_DATA_START = .;
        _8BE60_bin = .;
        build/assets/8BE60.bin.o(.data);
        _8BE60_DATA_END = .;
        _8BE60_DATA_SIZE = ABSOLUTE(_8BE60_DATA_END - _8BE60_DATA_START);
    }
    __romPos += SIZEOF(._8BE60);
    _8BE60_ROM_END = __romPos;
    _8BE60_VRAM_END = .;

    /DISCARD/ :
    {
        *(*);
    }
}
